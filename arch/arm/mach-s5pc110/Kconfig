## linux-2.6.29/drivers/video/samsung/Kconfig
```kconfig
#
# S3C Video configuration
#

config FB_S3C
	tristate "S3C Framebuffer support"
	select FB_CFB_FILLRECT
	select FB_CFB_COPYAREA
	select FB_CFB_IMAGEBLIT
	select FRAMEBUFFER_CONSOLE_DETECT_PRIMARY
	depends on FB && (ARCH_S3C64XX || ARCH_S5P64XX || ARCH_S5PC1XX || ARCH_S5PC11X)
	default n
	---help---
	  This enables support for Samsung Display Controller (FIMD)

config FB_S3C_DEBUG
        bool "S3C Framebuffer debug messages"
        depends on FB_S3C

config FB_S3C_TRACE_UNDERRUN
	bool "S3C Framebuffer FIFO underrun trace"
	depends on FB_S3C

config FB_S3C_DEFAULT_WINDOW
	int "Default Window (0-4)"
	depends on FB_S3C
	default "1"
	---help---
	  This indicates the default window number, and which is used as console framebuffer

config FB_S3C_YPANSTEP
	int "Vertical Panning Step (0-2)"
	depends on FB_S3C
	default "1"
	---help---
	  This indicates the number of vertical steps for pan display, 0 means no pan display and
	  1 means the double size of video buffer will be allocated for default window

choice
depends on FB_S3C
prompt "Select LCD Type"
default FB_S3C_LTE480WV
config FB_S3C_LTE480WV
	bool "LTE480WV"
	depends on MACH_SMDKC100 || MACH_SMDK6442
	---help---
	  This enables support for Samsung LTE480WV 4.8\" WVGA LCD panel

config FB_S3C_TL2796
	bool "TL2796"
	depends on (MACH_SMDKC110 || MACH_S5PC110_JUPITER)
	select SPI
	select SPI_GPIO
	select SPI_BITBANG
	---help---
	  This enables support for Samsung TL2796 WVGA LCD panel

config FB_S3C_LVDS
	bool "LVDS"
	depends on MACH_S5PC110_P1P2
	---help---
	  This enables support for Samsung LVDS LCD panel

endchoice	

config FB_S3C_MDNIE
	bool "Samsung MDNIE"
	depends on FB_S3C
	depends on (MACH_SMDKC110 || MACH_S5PC110_JUPITER)
	default "0"
	---help---
	  This enables support for Samsung MDNIE feature
```

## linux-2.6.29/sound/soc/s3c/Kconfig
```kconfig
config SND_S5P_SOC
	tristate "Samsung SoC Audio"
	depends on ARCH_S5PC1XX || ARCH_S5PC11X || ARCH_S5P64XX
	help
	  Say Y or M if you want to add support for codecs attached to
	  the S3C AC97, I2S or SSP interface. You will also need
	  to select the audio interfaces to support below.

config SND_S3C_I2S_V50
	tristate

config SND_S3C_AC97
	tristate
config SND_S3C_PCMDEV
	tristate

config  SND_C110_PCM
        tristate "PCM-wm8994 device"
        depends on ARCH_S5PC11X && SND_UNIVERSAL_WM8994
        select SND_S3C_PCMDEV
       select SND_SOC_WM8994_PCM

choice
	prompt "Select the codec driver"
	depends on SND_S5P_SOC

config  SND_SMDKC110_WM8580
	tristate "WM8580-I2S on SMDKC110"
	depends on ARCH_S5PC11X
	select SND_S3C_I2S_V50
	select SND_SOC_WM8580

config  SND_UNIVERSAL_WM8994
	tristate "WM8994-I2S on UNIVERSAL"
	depends on ARCH_S5PC11X
	select SND_S3C_I2S_V50
	select SND_SOC_WM8994

config	SND_UNIVERSAL_WM8994_MASTER
	bool "WM8994 master"
	depends on SND_UNIVERSAL_WM8994
	default y

config  SND_SMDKC100_WM8580
	tristate "WM8580-I2S on SMDKC100"
	depends on ARCH_S5PC1XX
	select SND_S3C_I2S_V50
	select SND_SOC_WM8580

config  SND_SMDKC110_WM8580_PCM
	tristate "WM8580-PCM on SMDKC110"
	depends on ARCH_S5PC11X
	select SND_S3C_PCMDEV
	select SND_SOC_WM8580_PCM 

config  SND_SMDKC100_S5M8751
	tristate "S5M8751-I2S on SMDKC100"
	depends on ARCH_S5PC1XX
	select SND_S3C_I2S_V32
	select SND_SOC_S5M8751

config  SND_SMDKC100_WM9713
	tristate "WM9713-AC97 on SMDKC100"
	depends on ARCH_S5PC1XX
	select SND_S3C_AC97
	select SND_SOC_WM9713

config SND_S5PC100_SOC_UNIVERSAL_AK4671
	tristate "SoC I2S Audio support for UNIVERSAL - AK4671"
	depends on ARCH_S5PC1XX
	select SND_S3C_I2S_V50
	select SND_SOC_AK4671
	select SND_SOC_MAX9877
	help
	  Say Y if you want to add support for SoC audio on universal
	  with the AK4671.

config  SND_SMDK6442_WM8580
	tristate "WM8580-I2S on SMDK6442"
	depends on ARCH_S5P64XX
	select SND_S3C_I2S_V50
	select SND_SOC_WM8580

endchoice

config  SND_WM8580_MASTER
	bool "WM8580 Codec is I2S Master"
	depends on SND_SMDKC110_WM8580 || SND_SMDKC100_WM8580 || SND_SMDK6442_WM8580
	default n
```

## linux-2.6.29/sound/soc/s5pc1xx/Kconfig
```kconfig
menu "SoC Audio for the Samsung S3C"
	depends on ARCH_S5PC1XX

config SND_S5PC1XX_SOC
	tristate "SoC Audio for the Samsung S3C chips"
	depends on ARCH_S5PC1XX
	select SND_PCM
	help
	  Say Y or M if you want to add support for codecs attached to
	  the S3C AC97, I2S or SSP interface. You will also need
	  to select the audio interfaces to support below.

config SND_S3C_SOC_I2S
	tristate

config SND_SOC_I2S_V50
	tristate

config SND_S5PC100_SOC_SPDIF
	tristate

config SND_SMDKC100_WM8580
	tristate "SoC I2S Audio support for SMDKC100 - WM8580"
	depends on SND_S5PC1XX_SOC && MACH_SMDKC100
	select SND_SOC_I2S_V50
	select SND_SOC_WM8580
	help
	  Say Y if you want to add support for SoC audio on smdk6410
	  with the WM8580.
	
choice
        prompt "SMDK Record Path Select"
	depends on SND_SMDKC100_WM8580

config SOUND_S5PC100_WM8580_INPUT_STREAM_LINE
	bool "Input Stream is LINE-IN"
	depends on SND_SMDKC100_WM8580
	help
	  Say Y here to make input stream as LINE-IN.

config SOUND_S5PC100_WM8580_INPUT_STREAM_MIC
	bool "Input Stream is MIC"
	depends on SND_SMDKC100_WM8580
	help
	  Say Y here to make input stream as MIC.
endchoice

config SND_SMDKC100_WM9713
        tristate "SoC AC97 Audio support for SMDKC100 - WM9713"
        depends on SND_S5PC1XX_SOC && MACH_SMDKC100
        select SND_S5PC100_SOC_AC97
        select SND_SOC_WM9713
        help
          Say Y if you want to add support for SoC audio on SMDKC100
          with the WM9713.

choice
        prompt "SMDK Record Path Select"
        depends on SND_SMDKC100_WM9713 

config SOUND_S5PC100_WM9713_INPUT_STREAM_LINE
        bool "Input Stream is LINE-IN"
        depends on SND_SMDKC100_WM9713
        help
          Say Y here to make input stream as LINE-IN.

config SOUND_S5PC100_WM9713_INPUT_STREAM_MIC
        bool "Input Stream is MIC"
        depends on SND_SMDKC100_WM9713
        help
          Say Y here to make input stream as MIC.
endchoice

config SND_S5PC100_SOC_AC97
        tristate
        select AC97_BUS
        select SND_AC97_CODEC
        select SND_SOC_AC97_BUS
        
config SND_SMDKC100_SPDIF
		tristate "SoC SPDIF Audio support for SMDKC100"
		depends on SND_S5PC1XX_SOC && MACH_SMDKC100
		select SND_S5PC100_SOC_SPDIF
		help
          Say Y if you want to add support for SoC audio on SMDKC100
          with the SPDIF.
endmenu
```

## modules/Kconfig
```kconfig
#
# Samsung Modules
#

menuconfig MODULES_SAMSUNG
	bool "Samsung Modules"
	default y

config MODULES_DROP_CACHES
	bool "Drop Caches Module"
	default y
	depends on MODULES_SAMSUNG && m

config MODULES_DPRAM
	bool "DPRAM Module"
	default y
	depends on MODULES_SAMSUNG && m

config MODULES_CAMERA
	bool "Camera Module"
	default y
	depends on MODULES_SAMSUNG && m

config MODULES_WLAN
	bool "BCM4329 WLAN Module"
	default y
	depends on MODULES_SAMSUNG && m

config MODULES_MULTIMEDIA
	bool "Multimedia Modules"
	default y
	depends on MODULES_SAMSUNG && m

config FLASH_ONENAND
	bool "FS OneNand - FSR, RFS, J4FS"
	default y
	depends on MODULES_SAMSUNG && m

config MODULES_VIBETONZ
	bool "Vibetonz Module"
	default y
	depends on MODULES_SAMSUNG && m

config MODULES_ELED
	bool "eLED Module"
	default y
	depends on MODULES_SAMSUNG && m

config MODULES_BTGPIO
	bool "BTGPIO Module"
	default y
	depends on MODULES_SAMSUNG && m

config MODULES_FMRADIO
	bool "FM Radio Module"
	default y
	depends on MODULES_SAMSUNG && m

config MODULES_PARAM
 	bool "Param Module"
	default y
	depends on MODULES_SAMSUNG && m
```
