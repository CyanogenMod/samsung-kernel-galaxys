## arch/arm/mach-s5pc110/Kconfig
```kconfig
# arch/arm/mach-s5pc110/Kconfig
#
# Copyright 2008 Openmoko, Inc.
# Copyright 2008 Simtec Electronics
#
# Licensed under GPLv2

# Configuration options for the S5PC110 CPU

config CPU_S5PC110
	bool
	select CPU_S5PC110_INIT
	select CPU_S5PC110_CLOCK
	help
	  Enable S5PC110 CPU support

config S5PC11X_SETUP_SDHCI
        bool
        help
          Internal helper functions for S5PC1XX based SDHCI systems

config MACH_SMDKC110
	bool
	select CPU_S5PC110
	select S3C_DMA_PL330
	select S3C_DEV_I2C1
	select S3C_DEV_HSMMC
	select S3C_DEV_HSMMC1
	select S3C_DEV_HSMMC2
	select S3C_DEV_HSMMC3       
	select S5PC11X_SETUP_SDHCI
	select ARCH_DISCONTIGMEM_ENABLE
	help
	  Machine support for the Samsung SMDKC110
config MACH_S5PC110_P1P2
	bool
	select CPU_S5PC110
	select S3C_DMA_PL330
	select S3C_DEV_I2C1
	select S3C_DEV_HSMMC2
	select S5PC11X_SETUP_SDHCI
	select ARCH_DISCONTIGMEM_ENABLE
	help
	  Machine support for the UNIVERSAL P1P2 

config SEC_INTERNAL_STORAGE
        bool "Select SEC_INTERNAL_STORAGE"
        select S3C_DEV_HSMMC
        help
          Provides support for samsung internal storage
	
	 
config MACH_S5PC110_JUPITER
	bool
	select CPU_S5PC110
	select S3C_DMA_PL330
	select S3C_DEV_I2C1
	select S3C_DEV_HSMMC1
	select S3C_DEV_HSMMC2
	select S5PC11X_SETUP_SDHCI
	select ARCH_DISCONTIGMEM_ENABLE
	help
	  Machine support for the UNIVERSAL JUPITER 


choice
        prompt "Setup CPU Type for S5PC110"
        depends on PLAT_S5PC11X
	default S5PC110_H_TYPE


config S5PC110_H_TYPE
        bool "Select H-Type"
        depends on PLAT_S5PC11X
        help
					Select H-Type of S5PC110

config S5PC110_AC_TYPE
        bool "select AC-Type"
        depends on PLAT_S5PC11X
        help
					Select AC-Type of S5PC110
endchoice

choice
	prompt "Select S5PC110 BOARD TYPE "
	depends on PLAT_S5PC11X
	default S5PC110_JUPITER

config 	S5PC110_JUPITER_BOARD
	bool "S5PC110_JUPITER"
	select MACH_S5PC110_JUPITER
	help
		select UNIVRSAL_JUPITER Board 

config 	S5PC110_P1P2_BOARD
	bool "S5PC110_P1P2"
	select MACH_S5PC110_P1P2
	help
		select UNIVRSAL_P1P2 Board 

config	SMDKC110_BOARD
	bool "Select SMDKC110_BOARD"
	select MACH_SMDKC110
	help
		select SMDKC110

endchoice

choice
        prompt "Select JUPITER BOARD VERSION "
config JUPITER_VER_B3
        bool "Select JUPITER VERSION B3"
        depends on S5PC110_JUPITER_BOARD
        help
                                        Select H-Type of S5PC110

config JUPITER_VER_B4
        bool "select JUPITER VERSION B4"
        depends on S5PC110_JUPITER_BOARD
        help
                                        Select AB-Type of S5PC110
                                        
config JUPITER_VER_B5
        bool "select JUPITER VERSION B5"
        depends on S5PC110_JUPITER_BOARD
        help
                                        Select AB-Type of S5PC110   

config ARIES_VER_B0
        bool "select ARIES VERSION B0"
        depends on S5PC110_JUPITER_BOARD
        help
                                        Select AB-Type of S5PC110   

config ARIES_VER_B1
        bool "select ARIES VERSION B1"
        depends on S5PC110_JUPITER_BOARD
        help
                                        Select AB-Type of S5PC110   

config ARIES_VER_B2
        bool "select ARIES VERSION B2"
        depends on S5PC110_JUPITER_BOARD
        help
                                        Select AB-Type of S5PC110   
                                        
config ARIES_VER_B3
        bool "select ARIES VERSION B3"
        depends on S5PC110_JUPITER_BOARD
        help
                                        Select AB-Type of S5PC110  
endchoice

choice
        prompt "Select JUPITER RAM SIZE "
config DDR_RAM_3G
        bool "Select DDR RAM 3G"
        depends on S5PC110_JUPITER_BOARD
        help
                                        Select H-Type of S5PC110

config DDR_RAM_2G
        bool "select DDR RAM 2G"
        depends on S5PC110_JUPITER_BOARD
        help
                                        Select AB-Type of S5PC110
                                        
endchoice

choice
	prompt "Select NA USA BOARD TYPE "

config S5PC110_KEPLER_BOARD
	bool "S5PC110_KEPLER"
	help
		select NA USA Board 

config S5PC110_T959_BOARD
	bool "S5PC110_T959"
	help
		select NA USA Board 

config S5PC110_FLEMING_BOARD
	bool "S5PC110_FLEMING"
	help
		select NA USA Board 
endchoice

choice 
        prompt "Select KEPLER BOARD VERSION "
config KEPLER_VER_B0
        bool "add KEPLER VERSION B0"
        depends on S5PC110_KEPLER_BOARD
        help
         add kepler ver B0 option 

config KEPLER_VER_B2
        bool "add KEPLER VERSION B2"
        depends on S5PC110_KEPLER_BOARD
        help
         add kepler ver B2 option 
         
config KEPLER_VER_B3
        bool "add KEPLER VERSION B3"
        depends on S5PC110_KEPLER_BOARD
        help
         add kepler ver B3 option         
         
endchoice 

choice 
	prompt "Select T959 BOARD VERSION"
	
config BEHOLD3_VER_B0
        bool "add BEHOLD3 VERSION"
        depends on S5PC110_T959_BOARD
        help
         add behold3 ver B0 option 
         
config T959_VER_B0
        bool "add T959 VERSION"
         depends on S5PC110_T959_BOARD
        help
         add T959 ver B0 option 

config T959_VER_B5
        bool "add T959 VERSION"
         depends on S5PC110_T959_BOARD
        help
         add T959 ver B5 option 
         
endchoice 

choice 
	prompt "Select FLEMING BOARD VERSION"
         
config FLEMING_VER_B0
        bool "add FLEMING VERSION"
         depends on S5PC110_FLEMING_BOARD
        help
         add FLEMING ver B0 option 
endchoice 

config SEC_HEADSET
        tristate "SEC 2 Wire detection driver"
        default n
        help
         Provides support for detecting SEC 2 wire devices, such as wired
         headset.
```

## arch/arm/plat-s5pc11x/Kconfig
```kconfig
# arch/arm/plat-s5pc11x/Kconfig
#
# Copyright 2008 Openmoko, Inc.
# Copyright 2008 Simtec Electronics
#	Ben Dooks <ben@simtec.co.uk>
#
# Licensed under GPLv2

config PLAT_S5PC11X
	bool
	depends on ARCH_S5PC11X
	select CPU_V7
	select PLAT_S3C
	select ARM_VIC
	default y
	select NO_IOPORT
	select ARCH_REQUIRE_GPIOLIB
	select S3C_GPIO_TRACK
	select S3C_GPIO_PULL_UPDOWN
	select S3C_GPIO_CFG_S5PC1XX
	select DMABOUNCE
	help
	  Base platform code for any Samsung S5PC1XX device


if PLAT_S5PC11X
# Configuration options shared by all S5PC1XX implementations

config CPU_S5PC100_INIT
	bool
	depends on CPU_S5PC100
	default y
	help
	  Common initialisation code for the S5PC100 that is shared
	  by other CPUs in the series, such as the S5PC100.

config CPU_S5PC100_CLOCK
	bool
	depends on CPU_S5PC100
	default y	
	help
	  Common clock support code for the S5PC100 that is shared
	  by other CPUs in the series, such as the S5PC110.

config CPU_S5PC110_INIT
	bool
	depends on CPU_S5PC110
	default y	
	help
	  Common initialisation code for the S5PC100 that is shared
	  by other CPUs in the series, such as the S5PC110.

config CPU_S5PC110_CLOCK
	bool
	depends on CPU_S5PC110
	default y	
	help
	  Common clock support code for the S5PC100 that is shared
	  by other CPUs in the series, such as the S5PC110.

# platform specific device setup

config S5PC11X_SETUP_I2C0
	bool
	default y
	help
	  Common setup code for i2c bus 0.

	  Note, currently since i2c0 is always compiled, this setup helper
	  is always compiled with it.

config S5PC11X_SETUP_I2C1
	bool
	default y
	help
	  Common setup code for i2c bus 1.

config S5PC11X_SETUP_I2C2
	bool
	default y
	help
	  Common setup code for i2c bus 2.

config S5PC11X_ADC
        bool "S5PC1XX ADC Driver"
        depends on PLAT_S5PC11X
        help
          ADC (A/D Conversion) driver for Samsung S5PC1XX.

# MIPI-CSIS part
config S5PC11X_DEV_CSIS
	bool
	default y
	help
	  Compile in platform device definitions for MIPI-CSIS

config S5PC11X_SETUP_CSIS
	bool
	default y
	help
	  Common setup code for MIPI-CSIS

# IPC part
config S5PC11X_DEV_IPC
	bool
	default y
	help
	  Compile in platform device definitions for IPC

config S5PC11X_SETUP_IPC
	bool
	default y
	help
	  Common setup code for IPC

# FIMC part
config S5PC11X_DEV_FIMC0
	bool
	default y
	help
	  Compile in platform device definitions for FIMC controller 0

config S5PC11X_DEV_FIMC1
	bool
	default y
	help
	  Compile in platform device definitions for FIMC controller 1

config S5PC11X_DEV_FIMC2
	bool
	default y
	help
	  Compile in platform device definitions for FIMC controller 2

config S5PC11X_SETUP_FIMC0
	bool
	default y
	help
	  Common setup code for FIMC controller 0.

config S5PC11X_SETUP_FIMC1
	bool
	default y
	help
	  Common setup code for FIMC controller 1.

config S5PC11X_SETUP_FIMC2
	bool
	default y
	help
	  Common setup code for FIMC controller 2.

# FB part
config S5PC11X_DEV_FB
	bool
	depends on FB_S3C
	default y
	help
	  Compile in platform device definitions for FIMD controller

config S5P_HAVE_PWM
        bool "PWM device support"
        select HAVE_PWM
        help
           Support for exporting the PWM timer blocks via the pwm device
endif

# option for OS tick timer (fixed/dynamic)
choice
        prompt "OS Timer support "
        default DYNAMIC_TIMER

config FIXED_TIMER
        bool "Fixed Tick timer"

config DYNAMIC_TIMER
        bool "Tickless and HR Timer"
        select GENERIC_TIME
        select GENERIC_CLOCKEVENTS

endchoice
```

## arch/arm/plat-s5pc1xx/Kconfig
```kconfig
# arch/arm/plat-s5pc1xx/Kconfig
#
# Copyright 2008 Openmoko, Inc.
# Copyright 2008 Simtec Electronics
#	Ben Dooks <ben@simtec.co.uk>
#
# Licensed under GPLv2

config PLAT_S5PC1XX
	bool
	depends on ARCH_S5PC1XX
	select CPU_V7
	select PLAT_S3C
	select ARM_VIC
	default y
	select NO_IOPORT
	select ARCH_REQUIRE_GPIOLIB
	select S3C_GPIO_TRACK
	select S3C_GPIO_PULL_UPDOWN
	select S3C_GPIO_CFG_S5PC1XX
	select DMABOUNCE
	help
	  Base platform code for any Samsung S5PC1XX device


if PLAT_S5PC1XX
# Configuration options shared by all S5PC1XX implementations

config CPU_S5PC100_INIT
	bool
	depends on CPU_S5PC100
	default y
	help
	  Common initialisation code for the S5PC100 that is shared
	  by other CPUs in the series, such as the S5PC1XX.

config CPU_S5PC100_CLOCK
	bool
	depends on CPU_S5PC100
	default y	
	help
	  Common clock support code for the S5PC100 that is shared
	  by other CPUs in the series, such as the S5PC1XX.

# platform specific device setup

config S5PC1XX_SETUP_I2C0
	bool
	default y
	help
	  Common setup code for i2c bus 0.

	  Note, currently since i2c0 is always compiled, this setup helper
	  is always compiled with it.

config S5PC1XX_SETUP_I2C1
	bool
	default y
	help
	  Common setup code for i2c bus 1.

config S5PC1XX_ADC
        bool "S5PC1XX ADC Driver"
        depends on PLAT_S5PC1XX
        help
          ADC (A/D Conversion) driver for Samsung S5PC1XX.

# FIMC part
config S5PC1XX_DEV_FIMC0
	bool
	default y
	help
	  Compile in platform device definitions for FIMC controller 0

config S5PC1XX_DEV_FIMC1
	bool
	default y
	help
	  Compile in platform device definitions for FIMC controller 1

config S5PC1XX_DEV_FIMC2
	bool
	default y
	help
	  Compile in platform device definitions for FIMC controller 2

config S5PC1XX_SETUP_FIMC0
	bool
	default y
	help
	  Common setup code for FIMC controller 0.

config S5PC1XX_SETUP_FIMC1
	bool
	default y
	help
	  Common setup code for FIMC controller 1.

config S5PC1XX_SETUP_FIMC2
	bool
	default y
	help
	  Common setup code for FIMC controller 2.

# FB part
config S5PC1XX_DEV_FB
	bool
	depends on FB_S3C
	default y
	help
	  Compile in platform device definitions for FIMD controller

# MIPI-CSIS part
config S5PC1XX_DEV_CSIS
	bool
	default y
	help
	  Compile in platform device definitions for MIPI-CSIS

config S5PC1XX_SETUP_CSIS
	bool
	default y
	help
	  Common setup code for MIPI-CSIS

config S5P_HAVE_PWM
        bool "PWM device support"
        select HAVE_PWM
        help
           Support for exporting the PWM timer blocks via the pwm device

endif
```

## linux-2.6.29/arch/arm/mach-s5pc100/Kconfig
```kconfig
# arch/arm/mach-s5pc100/Kconfig
#
# Copyright 2008 Openmoko, Inc.
# Copyright 2008 Simtec Electronics
#
# Licensed under GPLv2

# Configuration options for the S5PC100 CPU

config CPU_S5PC100
	bool
	depends on ARCH_S5PC1XX
	select CPU_S5PC100_INIT
	select CPU_S5PC100_CLOCK
	help
	  Enable S5PC100 CPU support

config S5PC1XX_SETUP_SDHCI
        bool
        help
          Internal helper functions for S5PC1XX based SDHCI systems

config MACH_SMDKC100
	bool "SMDKC100"
	select CPU_S5PC100
	select S3C_DMA_PL330
	select S3C_DEV_I2C1
        select S3C_DEV_HSMMC
        select S3C_DEV_HSMMC1
        select S5PC1XX_SETUP_SDHCI
	select S3C64XX_SETUP_I2C1
	help
	  Machine support for the Samsung SMDKC100
```

## linux-2.6.29/drivers/inform/Kconfig
```kconfig
config REBOOT_INFORM 
	bool " support"
	help
	  Say Y here to enable reboot parameter access. 
```

## linux-2.6.29/drivers/sensor/accel/Kconfig
```kconfig
#
# Accelerometer Sensor Configuration
#



config ACCEL                                                              
	bool "Accelerometer Sensor"
	default y
	help
	This option enables accelerometer sensors  
	   
config ACCEL_SMB380
	depends on ACCEL
	tristate "ACCEL_SMB380 driver for s5pc110"
	default y
	help
	  This option enables accelerometer sensors using bma020 driver.
	  It is optimized for s3c6410.
```

## linux-2.6.29/drivers/tfsr/Kconfig
```kconfig
#
# Unified Flash Device configuration
#

menu "TinyFSR Support for cramfs"

config TINY_FSR
	bool "Using TinyFSR for Cramfs"
	default y
	help
	  eXtended Sector Remapper device

choice
	depends on TINY_FSR
	prompt "OneNAND type"
	default ONENAND

config ONENAND
	bool "OneNAND 2K page"
	
config ONENAND_4K
	bool "OneNAND 4K page"

config FLEXOND
	bool "FlexOneNAND"

endchoice

config TINY_FLASH_PHYS_ADDR
        hex "Flex-OneNAND flash Physical Location"
        depends on TINY_FSR
        default "0xB0000000"
        help
          This is the physical address in your flash memory the fsr will
          be linked for and stored to.  This address is dependent on your
          own flash usage.

config LINUSTOREIII_TINY_DEBUG_VERBOSE
	int "LinuStoreIII Tiny Debugging verbosity (0 = quiet, 3 = noisy)"
	depends on TINY_FSR
	default 0

endmenu
```
